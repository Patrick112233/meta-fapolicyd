## conf/layer.conf
```bitbake
# We have a conf and classes directory, add to BBPATH
BBPATH .= ":${LAYERDIR}"

# We have recipes-* directories, add to BBFILES
BBFILES += "${LAYERDIR}/recipes-*/*/*.bb \
            ${LAYERDIR}/recipes-*/*/*.bbappend"

BBFILE_COLLECTIONS += "meta-fapolicyd"
BBFILE_PATTERN_meta-fapolicyd = "^${LAYERDIR}/"
BBFILE_PRIORITY_meta-fapolicyd = "6"

LAYERDEPENDS_meta-fapolicyd = "core"
LAYERSERIES_COMPAT_meta-fapolicyd = "scarthgap"
```
